## firmware/companion/main/Kconfig.projbuild
```kconfig
menu "Companion"

config PROTOTYPE_PLAYLIST_ID
    string "PROTOTYPE_PLAYLIST_ID: Navidrome playlist to synchronise"
    default ""
    help
        TODO(PROTOTYPE): the prototype synchronises exactly one Navidrome playlist. This is the
        build-time default for the `nd_playlist` configuration key, which can be changed at
        runtime (watch Settings or the LAN settings page) without reflashing. Production firmware will
        sync a user-selected set of playlists.

config COMPANION_PAIRING_WINDOW_S
    int "Seconds after boot during which new BLE pairings are accepted even when already paired"
    default 300

config COMPANION_PROTOTYPE_PASSKEY
    int "Fixed BLE pairing passkey"
    range 0 999999
    default 616616
    help
        TODO(PROTOTYPE): the prototype uses one fixed, publicly known 6-digit passkey so the
        watch can pair without reading the serial console. Anyone in radio
        range while it is unpaired (or during the post-boot window) can bond with it. Production firmware must use a
        per-device random passkey (or a passkey shown on a display).

config COMPANION_SIM_LAT_E7
    int "Simulated GPS latitude (1e-7 deg)"
    default 437800833
    help
        TODO(PROTOTYPE): 43 deg 46' 48.3" N. Replaced by EG912U GNSS in the production companion.

config COMPANION_SIM_LON_E7
    int "Simulated GPS longitude (1e-7 deg)"
    default -794118611
    help
        TODO(PROTOTYPE): 79 deg 24' 42.7" W.

endmenu
```
